/*
  Copyright (c) 2020 LHW - createskyblue
  Arduino-Pomodoro is licensed under Mulan PSL v2.
  You can use this software according to the terms and conditions of the Mulan PSL v2.
  You may obtain a copy of Mulan PSL v2 at:
         http://license.coscl.org.cn/MulanPSL2
  THIS SOFTWARE IS PROVIDED ON AN "AS IS" BASIS, WITHOUT WARRANTIES OF ANY KIND,
  EITHER EXPRESS OR IMPLIED, INCLUDING BUT NOT LIMITED TO NON-INFRINGEMENT,
  MERCHANTABILITY OR FIT FOR A PARTICULAR PURPOSE.
  See the Mulan PSL v2 for more details.

  光电门下位机程序版本:
  V2.0
*/
#include <U8g2lib.h>
//#include <SPI.h>
//U8G2_ST7565_JLX12864_F_4W_SW_SPI u8g2(U8G2_R0,19,20,14,22,21);
U8G2_SSD1306_128X64_NONAME_F_HW_I2C u8g2(U8G2_R0, /* clock=*/ PB6, /* data=*/ PB7, /* reset=*/ U8X8_PIN_NONE);
#define TmpDateMax 64
int DATA[2][TmpDateMax]; //目标传感器|历史数据
bool TriggerTimer = false;
bool GUIState = false;
bool State[2] = {1, 1}; //传感器状态
int grap[2][17]; //图形缓冲区
byte GrapX;
int DataDeal[2][2]; //目标传感器|累加&去抖均值
unsigned long timestamp[2][3]; //目标传感器|电平突变起始&电平突变结束&突变维持时间
unsigned long deltaT; //A,B传感器从起始到结束的时间差
unsigned long GrapSampling; //波形捕获时间戳
#define SysVersion 2.0
#define MutationThreshold 100
#define SamplingRate 10
#define PI 3.141592654
byte io[2] = {0, 1};
byte a = 0;
int LightIntensity = 0;
// width: 128, height: 64
const unsigned char Logo1[] PROGMEM = { 0xff, 0xbb, 0x56, 0x21, 0x00, 0x04, 0x81, 0xdb, 0xb6, 0xff, 0xff, 0xff, 0xff,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 0x7f, 0xfe };
const unsigned char Logo2[] PROGMEM = { 0xff, 0xff, 0xff, 0xff, 0xff, 0xff, 0xff, 0xff, 0xff, 0xff, 0xff, 0xff, 0xff,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 0xff, 0xff };
//60x60
const unsigned char QRCode[] PROGMEM = { 0xff, 0xff, 0xff, 0xff, 0xff, 0xff, 0xff, 0x0f, 0xff, 0xff, 0xff, 0xff, 0xff,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 0xff, 0x0f };
//32x32
const unsigned char photoresistance[] PROGMEM = { 0xf0, 0xff, 0xff, 0x0f, 0x88, 0x02, 0x00, 0x18, 0x88, 0xff, 0x3f, 0x18, 0x04,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 0xff, 0x0f };
//82x16
const unsigned char Error1[] PROGMEM = { 0xbf, 0xf7, 0x0f, 0xe0, 0x01, 0x80, 0xbf, 0x7f, 0x00, 0xfd, 0x03, 0x3f, 0x00,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 0xff, 0x03 };
//66x64
const unsigned char note[] PROGMEM = { 0xff, 0xff, 0xff, 0xff, 0xff, 0xff, 0xff, 0xff, 0x03, 0xff, 0xff, 0xff, 0xff,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 0xff, 0x03 };
// width: 128, height: 64
const unsigned char TestModeNote[] PROGMEM = { 0xff, 0xff, 0xff, 0xff, 0xfd, 0xdf, 0xfd, 0xfd, 0xbd, 0xfb, 0xdf, 0xff, 0xff,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 0xff, 0xff };
// width: 51, height: 27
const unsigned char BANote[] PROGMEM  = { 0xfc, 0xff, 0xff, 0xff, 0xff, 0xff, 0x01, 0x02, 0x00, 0x00, 0x00, 0x00, 0x40,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 0xff, 0x01 };
void setup() {
  Serial.begin(115200);
  u8g2.begin();
  u8g2.setFont(u8g2_font_6x13_tf);
  u8g2.setFontDirection(0); //设置字体方向
  u8g2.setCursor(0, 12);
  u8g2.print(">_ booting");
  u8g2.setCursor(0, 24);
  u8g2.sendBuffer();
  delay(200);
  u8g2.print("F/W:  ");
  u8g2.print(SysVersion);
  Serial.println(String("F/W: ") + SysVersion);
  u8g2.setCursor(0, 36);
  u8g2.print("Auto white balance");
  u8g2.setCursor(0, 62);
  u8g2.print("LHW - createskyblue");
  u8g2.sendBuffer();
  delay(200);
  LightIntensity = ((analogRead(0) + analogRead(1)) / 2);
  //if (LightIntensity % 2) u8g2.drawXBMP(0, 0, 128, 64, Logo1); else u8g2.drawXBMP(0, 0, 128, 64, Logo2);
  BootAnimation(); //启动动画
  u8g2.sendBuffer();
  delay(1000);
  if (analogRead(0) > LightIntensity * 1.2 | analogRead(1) > LightIntensity * 1.2) TestMode();

  //显示项目二维码
  u8g2.clear();
  u8g2.drawXBMP(0, 2, 60, 60, QRCode);
  u8g2.drawXBMP(62, 0, 66, 64, note);
  u8g2.sendBuffer();
  delay(2000);

  u8g2.setFontMode(1); //字体模式:透明
  u8g2.setDrawColor(2); //设置字体前景颜色:xor
  GUI();
}

void loop() {
  collect();
  MakeGrap();
  SerialOutPut();
  //if (State[0]&State[1] & timestamp[1][1] > timestamp[0][0]) GUI(); //捕捉信号时限制刷新画面以保证采样性能  //因为动画带来不必要的刷新过于消耗资源，所以禁用了
}
//启动动画
void BootAnimation() {
  byte BAPointObj_PD_X = 48;
  //动画第一阶段：光敏电阻
  for (BAPointObj_PD_X; BAPointObj_PD_X > 16; BAPointObj_PD_X--) {
    u8g2.clearBuffer();
    Draw_BAPointObj_BJ();
    Draw_BAPointObj_PD(BAPointObj_PD_X, map(BAPointObj_PD_X, 48, 16, 0, 12));
    u8g2.sendBuffer();
  }
  //第二阶段：标题->sin(x)
  for (float x = 0; x < 2 * PI; x += 0.1) {
    u8g2.clearBuffer();
    Draw_BAPointObj_BJ();
    u8g2.setDrawColor(0);
    u8g2.drawXBMP(byte(32 + x * 5.09), byte(20 + sin(x) * 16), 51, 27, BANote); //浮动的标题
    Draw_BAPointObj_PD(16, 12);
    u8g2.sendBuffer();
  }
  //最后阶段：首创者信息
  u8g2.drawBox(0, 51, 128, 14 );
  u8g2.setDrawColor(1);
  u8g2.setCursor(4, 62);
  u8g2.print("LHW - createskyblue");
}
void Draw_BAPointObj_PD(byte x, byte y) {
  u8g2.drawXBMP(x, y, 32, 32, photoresistance);
  u8g2.drawLine(x + 3, y + 32, x + 3, y + 60);
  u8g2.drawLine(x + 27, y + 32, x + 27, y + 60);
}
void Draw_BAPointObj_BJ() {
  u8g2.setDrawColor(1);
  u8g2.drawBox(0, 0, 128, 64 );
  u8g2.setDrawColor(0);
}
void SerialOutPut() {
  int CheckCode = 4096 + DataDeal[0][1] + DataDeal[1][1] - LightIntensity + timestamp[0][2] + timestamp[1][2] + deltaT;
  Serial.println((4096 - LightIntensity) + String(",") + DataDeal[0][1]  + String(",") + DataDeal[1][1]  + String(",") + CheckCode + String(",") + timestamp[0][2] + String(",") + timestamp[1][2] + String(",") + deltaT + String(","));
}
void collect() {
  int IoALeng = sizeof(io) / sizeof(io[0]);
  bool Trigger = false;
  for (byte Iio = 0; Iio < IoALeng; Iio++) {
    //进行数据移位
    DataDeal[Iio][0] = 0; //移位前把历史累加数据清零
    for (int i = 0; i < TmpDateMax - 1; i++) {
      DATA[Iio][i] = DATA[Iio][i + 1];
      DataDeal[Iio][0] += DATA[Iio][i + 1];
    }
    //写入新的传感器数据
    //DATA[Iio][7] = analogRead(io[Iio]) - LightIntensity;
    DATA[Iio][TmpDateMax - 1] = analogRead(io[Iio]);
    DataDeal[Iio][0] += DATA[Iio][TmpDateMax - 1];
    DataDeal[Iio][1] = DataDeal[Iio][0] / float(TmpDateMax); //计算均值
    //记录电平突变时间戳
    Trigger = false;
    //限定幅度均值动态调整，效率高 v1.2
    // Serial.println(Iio+String("->目前：") + DATA[Iio][TmpDateMax-1] + String("大于阈值：") + (1.2 * DataDeal[Iio][1])+String("小于阈值：") + (0.8 * DataDeal[Iio][1]));
    if (DATA[Iio][TmpDateMax - 1] > (1.05 * DataDeal[Iio][1]) && State[Iio] == 1) {
      // Serial.println(Iio+String("->####"));
      timestamp[Iio][0] = millis();
      State[Iio] = 0;
      //Serial.println(timestamp[1][0]+String(" , ")+timestamp[1][1]);
      //Serial.println(Iio + String("-触发电平突变起始 当前：") + DATA[Iio][0] + String("大于阈值：") + (DataDeal[Iio][1] + MutationThreshold));
    }
    if (DATA[Iio][TmpDateMax - 1] < (0.95 * DataDeal[Iio][1]) && millis() > timestamp[Iio][0] && State[Iio] == 0) {
      // Serial.println(Iio+String("->#############"));
      timestamp[Iio][1] = millis();
      Trigger = true;
      State[Iio] = 1;
      //Serial.println(timestamp[1][0]+String(" , ")+timestamp[1][1]);
    }
    if (Trigger) {
      timestamp[Iio][2] = timestamp[Iio][1] - timestamp[Iio][0];
      if (TriggerTimer) {
        if (timestamp[1][0] > timestamp[0][1]) {
          deltaT = timestamp[1][0] - timestamp[0][1];
          GUIState = true;
          GUI();
        } else {
          GUIState = false;
          GUI();
        }
        //Serial.println(Iio + String("-突变起始时间") + timestamp[Iio][0] + String("-突变结束时间") + timestamp[Iio][1] + String("-突变维持时间") + timestamp[Iio][2]);
        Trigger = false;
      }
      if (State[0] = 1) TriggerTimer = !TriggerTimer;
    }
  }
}

void TestMode() {
  u8g2.clearBuffer();
  u8g2.drawXBMP(0, 0, 128, 64, TestModeNote);
  for (byte i; i < 128; i += 1) {
    //delay(6);
    u8g2.setDrawColor(0);
    u8g2.drawBox(0, 60, i, 4);
    u8g2.sendBuffer();
  }
  u8g2.setDrawColor(1);
  if (analogRead(0) > LightIntensity * 1.4 | analogRead(1) > LightIntensity * 1.4) {
    GUIState = true;
    while (1) {
      u8g2.clearBuffer();
      //u8g2.drawBox(0, 0, 128, 64);
      u8g2.drawXBMP(0, 7, 128, 14, TestModeNote);
      grap[0][GrapX] = map(analogRead(io[0]), 0, 4095, 0, 33);
      grap[1][GrapX] = map(analogRead(io[1]), 0, 4095, 0, 33);
      GrapX++;
      if (GrapX >= 17) GrapX = 0;
      DrawWave();//绘制波形
      u8g2.drawLine(GrapX * 8, 28, GrapX * 8, 64); //扫描线
      u8g2.sendBuffer();
      delay(15);
    }
  }
}

void MakeGrap() {
  if (timestamp[1][1] < timestamp[0][0]) { //只捕捉实验范围内的信号，节省资源
    if (!State[0] && State[1] && GrapX > 8) {
      GrapX = 0;
      for (byte i = 0; i < 17; i++) {
        grap[0][i] = 0;
        grap[1][i] = 0;
      }
    }
    if (GrapX < 17 && GrapSampling + SamplingRate < millis()) {
      grap[0][GrapX] = map(DataDeal[0][1], 0, 4095, 0, 33);
      grap[1][GrapX] = map(DataDeal[1][1], 0, 4095 , 0, 33);
      GrapX++;
      GrapSampling = millis();
    }
  }
}
void GUI() {
  u8g2.clearBuffer();
  u8g2.setCursor(4, 12);
  if (GUIState) u8g2.drawBox(0, 0, 128, 26);
  u8g2.print("A ");
  u8g2.print(timestamp[0][2]);
  u8g2.print(" ms");
  u8g2.setCursor(64, 12);
  u8g2.print("B ");
  u8g2.print(timestamp[1][2]);
  u8g2.print(" ms");

  DrawWave();//绘制波形

  //显示时间差
  u8g2.setCursor(4, 24);
  if (GUIState) {
    u8g2.print("Diff-> ");
    u8g2.print(deltaT);
    u8g2.print(" ms");
  } else {
    if ((millis() / 1000) % 2|1) u8g2.drawBox(0, 14, 128, 12); //'|1'因为动画带来不必要的刷新过于消耗资源，所以禁用了
    u8g2.print("#Unrecognized Wave!");
    u8g2.drawXBMP(23, 36, 82, 16, Error1);
  }


  u8g2.sendBuffer();
}
void DrawWave() {
  //绘制图形框
  u8g2.drawFrame(0, 28, 128, 36);
  //绘制计数点，看起来更有逼格
  for (byte y = 29; y < 64; y += 8)
    for (byte x = 1; x < 128; x += 8)
      u8g2.drawPixel(x, y);
  //绘制实时曲线
  if (GUIState) for (int i = 0; i < 16; i++) {
      u8g2.drawLine(8 * i, 63 - grap[0][i], 8 * (i + 1), 63 - grap[0][i + 1]);
      u8g2.drawLine(8 * i, 63 - grap[1][i], 8 * (i + 1), 63 - grap[1][i + 1]);
    }
}
